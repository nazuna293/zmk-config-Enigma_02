## config/west.yml
```yaml
manifest:
  remotes:
    - name: zmkfirmware
      url-base: https://github.com/zmkfirmware
    - name: enigma-key
      url-base: https://github.com/enigma-key
    - name: ssbb
      url-base: https://github.com/ssbb
    - name: caksoylar
      url-base: https://github.com/caksoylar  
  projects:
    - name: zmk
      remote: zmkfirmware
      revision: main
      import: app/west.yml
    - name: zmk-pmw3610-driver
      remote: enigma-key
      revision: main
    - name: zmk-listeners
      remote: ssbb
      revision: v1
    - name: zmk-rgbled-widget
      remote: caksoylar
      revision: main
  self:
    path: config
```
