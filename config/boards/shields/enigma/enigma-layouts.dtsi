#include <physical_layouts.dtsi>

/ {
    enigma_layout: enigma_layout {
        compatible = "zmk,physical-layout";
        display-name = "Enigma_02_layout";
        transform = <&default_transform>;
        kscan = <&kscan0>;

        keys = <
            &key_physical_attrs 100 100 0 0 0 0 0    // RC(6,4)
            &key_physical_attrs 100 100 100 0 0 0 0    // RC(6,5)
            &key_physical_attrs 100 100 200 0 0 0 0    // RC(6,5)
        >;
    };
};
